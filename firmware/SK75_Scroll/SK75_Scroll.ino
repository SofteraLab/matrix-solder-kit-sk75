/*
  Softera Lab · Matrix Solder Kit · SK-75
  Scrolling text on the on-board ATtiny + MAX7219.

  Pins: DIN=D0 (PB0), CS=D3 (PB3), CLK=D2 (PB2)
  For a daisy-chain set NUM_DEVICES (OUT→IN).
*/

#include "SoftteraMax7219.h"
#include <avr/pgmspace.h>

static const uint8_t PIN_DIN = 0;
static const uint8_t PIN_CS  = 3;
static const uint8_t PIN_CLK = 2;
static const uint8_t NUM_DEVICES = 1;

SoftteraMax7219 matrix(PIN_DIN, PIN_CS, PIN_CLK, NUM_DEVICES);

// Minimal 5×7 uppercase A–Z + space
const uint8_t FONT[][5] PROGMEM = {
  {0x00,0x00,0x00,0x00,0x00}, // sp
  {0x7E,0x11,0x11,0x11,0x7E}, // A
  {0x7F,0x49,0x49,0x49,0x36}, // B
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  {0x61,0x51,0x49,0x45,0x43}, // Z
};

const char MSG[] = "  SK75 SOFTERA  ";

int glyphOf(char c) {
  if (c == ' ') return 0;
  if (c >= 'A' && c <= 'Z') return 1 + (c - 'A');
  if (c >= 'a' && c <= 'z') return 1 + (c - 'a');
  if (c >= '0' && c <= '9') return 0;
  return 0;
}

void drawAt(int16_t offset) {
  matrix.clear();
  int16_t x = -offset;
  for (uint8_t i = 0; MSG[i]; i++) {
    int gi = glyphOf(MSG[i]);
    for (uint8_t col = 0; col < 5; col++) {
      uint8_t bits = pgm_read_byte(&FONT[gi][col]);
      if (x >= 0 && x < 8 * NUM_DEVICES) {
        for (uint8_t y = 0; y < 7; y++) {
          if (bits & (1 << y)) matrix.setPixel((int8_t)x, (int8_t)(y + 1), true);
        }
      }
      x++;
    }
    x++;
  }
  matrix.show();
}

void setup() {
  matrix.begin(5);
}

void loop() {
  uint16_t w = (uint16_t)strlen(MSG) * 6;
  for (uint16_t o = 0; o < w; o++) {
    drawAt((int16_t)o);
    delay(70);
  }
}
